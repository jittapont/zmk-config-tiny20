## config/boards/shields/tiny20/Kconfig.defconfig
```kconfig
# Copyright (c) 2022 The ZMK Contributors
# SPDX-License-Identifier: MIT

if SHIELD_TINY20_LEFT

config ZMK_KEYBOARD_NAME
    default "Tiny20"

config ZMK_SPLIT_ROLE_CENTRAL
    default y

endif

if SHIELD_TINY20_LEFT || SHIELD_TINY20_RIGHT
config ZMK_SPLIT
    default y
endif
```
